## drivers/amlogic/mawell/8977bt/Kconfig
```kconfig
config MW8977_BT
	tristate "Mawell 8977 bt support"
	default n
	---help---
	  This module adds support for wireless adapters based on
	  Mawell 8977 chipset.
```

## drivers/amlogic/mawell/8977wifi/Kconfig
```kconfig
config MW8977_WIFI
	tristate "Marwell 8977 wifi support"
	default n
	select WIRELESS_EXT
	select WEXT_PRIV
	---help---
	  This module adds support for wireless adapters based on
	  Mawell 8977 chipset.
```

## sound/soc/aml/m8/Kconfig
```kconfig
#config  SND_AML_SPDIF
#	tristate "Amlogic S/PDIF codec support"
#	depends on SND_AML_M8_SOC
#	select SND_SOC_AML_SPDIF_CODEC if SND_AML_SPDIF
config SND_AML_M8
	tristate "AML-SND-M8 Board"
	depends on SND_AML_M8_SOC && SWITCH
	select SND_SOC_AML_M8_CODEC if SND_AML_M8
	select SND_SOC_RT5616 if SND_AML_M8
	select SND_SOC_DUMMY_CODEC
	select SND_SOC_WM8960
	select SND_SOC_RT5631
	select SND_SOC_AMLPMU3 if AML1218
	select SND_SOC_TLV320AIC3X
	select SND_SOC_TLV320AIC32X4

config SND_AML_M8_PCM
	tristate "M8 evaluation board with PCM2BT"
	depends on SND_AML_M8_SOC
	select SND_SOC_PCM2BT if SND_AML_M8_PCM
	
config SND_AML_M_DUMMY_CODEC
    tristate "AML M series board with DUMMY_CODEC"
    select SND_SOC_DUMMY_CODEC
if SND_AML_M8
config SND_AML_SPLIT_MODE
	tristate "AIU split mode, otherwise normal mode"
	depends on SND_AML_M8_SOC
	help
		Say 'Y' to enable AIU split mode. If not, it's normal mode.

config SND_AML_SPLIT_MODE_MMAP
	tristate "AIU split mode, mmap"
	depends on SND_AML_SPLIT_MODE
	depends on SND_AML_M8_SOC
	help
		Say 'Y' or 'N' to enable/disable AIU split mmap

endif
```
